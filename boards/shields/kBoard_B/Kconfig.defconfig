## boards/shields/kBoard_B/Kconfig.defconfig
```kconfig
# Copyright (c) 2022 The ZMK Contributors
# SPDX-License-Identifier: MIT

if SHIELD_KBOARD_B

config ZMK_KEYBOARD_NAME
    default "kBoard_B"

endif
```

## boards/shields/kBoard_B/Kconfig.shield
```kconfig
# Copyright (c) 2022 The ZMK Contributors
# SPDX-License-Identifier: MIT

config SHIELD_KBOARD_B
    def_bool $(shields_list_contains,kBoard_B)
```
